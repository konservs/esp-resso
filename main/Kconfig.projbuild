## main/Kconfig.projbuild
```kconfig
menu "ESP.Resso"

    config ESPRESSO_WIFI_ENABLE
        bool "Enable Wi-Fi dashboard"
        default y
        help
            Join a Wi-Fi network and serve a live statistics dashboard over HTTP.
            Disable for a fully offline machine.

    config ESPRESSO_WIFI_SSID
        string "Wi-Fi SSID (optional)"
        depends on ESPRESSO_WIFI_ENABLE
        default ""
        help
            Optional compiled-in network. Leave blank to provision Wi-Fi at
            runtime via the SoftAP setup portal (recommended). If set, it takes
            precedence over any portal-provisioned credentials.

    config ESPRESSO_WIFI_PASSWORD
        string "Wi-Fi password (optional)"
        depends on ESPRESSO_WIFI_ENABLE
        default ""

    config ESPRESSO_AP_SSID
        string "Setup-portal AP name"
        depends on ESPRESSO_WIFI_ENABLE
        default "ESP-Resso-setup"
        help
            SoftAP the device hosts when it has no working credentials, so you
            can join it and enter your Wi-Fi details from a phone/laptop.

    config ESPRESSO_AP_PASSWORD
        string "Setup-portal AP password"
        depends on ESPRESSO_WIFI_ENABLE
        default "espresso"
        help
            8-63 characters for a WPA2-protected setup AP, or blank for an open
            AP. The AP is only up during provisioning.

    config ESPRESSO_DASHBOARD_PORT
        int "Dashboard HTTP port"
        depends on ESPRESSO_WIFI_ENABLE
        default 80
        range 1 65535

    config ESPRESSO_WIFI_STATIC_IP
        bool "Use a static IP in station mode"
        depends on ESPRESSO_WIFI_ENABLE
        default n
        help
            Off = DHCP (the device asks your router for an address — default).
            On = use the fixed address below. Handy if you want a stable URL or
            to add a DHCP reservation isn't possible.

    config ESPRESSO_WIFI_IP
        string "Static IP address"
        depends on ESPRESSO_WIFI_STATIC_IP
        default "192.168.1.50"

    config ESPRESSO_WIFI_GATEWAY
        string "Gateway"
        depends on ESPRESSO_WIFI_STATIC_IP
        default "192.168.1.1"

    config ESPRESSO_WIFI_NETMASK
        string "Netmask"
        depends on ESPRESSO_WIFI_STATIC_IP
        default "255.255.255.0"

    config ESPRESSO_WIFI_DNS
        string "DNS server"
        depends on ESPRESSO_WIFI_STATIC_IP
        default "192.168.1.1"

endmenu
```

## sdkconfig.defaults
```kconfig
# Committed ESP-IDF defaults. The generated `sdkconfig` (git-ignored) is built
# from these on first configure; override locally with `idf.py menuconfig`.

# Target chip.
CONFIG_IDF_TARGET="esp32"

# 4 MB flash (typical ESP32-WROOM-32). Required by the two-OTA partition layout
# below (~3.1 MB). If your module has only 2 MB flash, drop one OTA slot in
# partitions.csv and set CONFIG_ESPTOOLPY_FLASHSIZE_2MB instead.
CONFIG_ESPTOOLPY_FLASHSIZE_4MB=y
CONFIG_ESPTOOLPY_FLASHSIZE="4MB"

# Custom partition table (two OTA slots + nvs) — see partitions.csv.
CONFIG_PARTITION_TABLE_CUSTOM=y
CONFIG_PARTITION_TABLE_CUSTOM_FILENAME="partitions.csv"

# 1 kHz FreeRTOS tick gives the control/safety loops fine-grained timing.
CONFIG_FREERTOS_HZ=1000

# Compiler: optimise for performance, treat warnings as errors in CI builds.
CONFIG_COMPILER_OPTIMIZATION_PERF=y

# Reasonable main task stack for app_main bring-up.
CONFIG_ESP_MAIN_TASK_STACK_SIZE=4096
```
